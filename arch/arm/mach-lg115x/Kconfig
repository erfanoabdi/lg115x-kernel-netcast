## arch/arm/mach-lg115x/Kconfig
```kconfig
menu "LG115x options"
	depends on ARCH_LG115X

choice
	prompt "LG115x system type"

config MACH_LG1152
	bool "LG1152-based board"
	select ARCH_HIBERNATION_POSSIBLE
	help
	 Include support for the LG1152-based board.

config MACH_LG1154
	bool "LG1154-based board"
	select ARCH_HIBERNATION_POSSIBLE
	select CLOCK_DETECTION
	help
	 Include support for the LG1154-based board.

endchoice

choice
	prompt "LG1152 chip revision"
	depends on MACH_LG1152

config LG1152_B0
	bool "LG1152 B0"
	select ARM_ERRATA_754322
	select ARM_ERRATA_764369
	select PL310_ERRATA_727915
	select PL310_ERRATA_753970
	select PL310_ERRATA_769419
	help
	  Cortex-A9 MPcore revision: r2p9
	  PL310 L2 Cache Controller revision: r3p0

endchoice

choice
	prompt "LG1154 chip revision"
	depends on MACH_LG1154

config LG1154_A0
	bool "LG1154 A0"
	select ARM_ERRATA_754322
	select ARM_ERRATA_764369
	help
	  Cortex-A9 MPcore revision: r3p0
	  PL310 L2 Cache Controller revision: r3p2

endchoice

config CLOCK_DETECTION
	bool

comment "Clocks and timers"

config AMBA_CLOCK_MHZ
	int "AMBA bus clock frequency (MHz)"
	default 198

config PERI_CLOCK_MHZ
	int "Cortex-A9 MPcore peripheral clock frequency (MHz)"
	default 396
	depends on LOCAL_TIMERS && !CLOCK_DETECTION

config SP804_CLOCKSOURCE_PRESET
	bool "Use preset mult/shift for the clocksource using SP804"
	default y

config SP804_CLOCKSOURCE_PRESET_MULT
	int "Preset mult"
	default 2711573867
	depends on SP804_CLOCKSOURCE_PRESET

config SP804_CLOCKSOURCE_PRESET_SHIFT
	int "Preset shift"
	default 29
	depends on SP804_CLOCKSOURCE_PRESET

comment "Level-2 cache controller options"

config L2CC_LATENCY_TAG
	hex "Intenal tag-RAM latency"
	default 0x333
	depends on CACHE_L2X0
	help
	  [10: 8] RAM write access latency
	  [ 6: 4] RAM read access latency
	  [ 2: 0] RAM setup latency
	  b000 = 1 cycle of latency, there is no additional latency.
	  b001 = 2 cycles of latency.
	  b010 = 3 cycles of latency.
	  b011 = 4 cycles of latency.
	  b100 = 5 cycles of latency.
	  b101 = 6 cycles of latency.
	  b110 = 7 cycles of latency.
	  b111 = 8 cycles of latency.

config L2CC_LATENCY_DATA
	hex "Internal data-RAM latency"
	default 0x333
	depends on CACHE_L2X0
	help
	  [10: 8] RAM write access latency
	  [ 6: 4] RAM read access latency
	  [ 2: 0] RAM setup latency
	  b000 = 1 cycle of latency, there is no additional latency.
	  b001 = 2 cycles of latency.
	  b010 = 3 cycles of latency.
	  b011 = 4 cycles of latency.
	  b100 = 5 cycles of latency.
	  b101 = 6 cycles of latency.
	  b110 = 7 cycles of latency.
	  b111 = 8 cycles of latency.

config L2CC_PREFETCH_DATA
	bool "Enable data-prefetch"
	default n
	depends on CACHE_L2X0

config L2CC_PREFETCH_INST
	bool "Enable instruction-prefetch"
	default n
	depends on CACHE_L2X0

config L2CC_PREFETCH_OFFSET
	int "Prefetch-offset (0-7, 15, 23, 31)"
	default 0
	depends on L2CC_PREFETCH_DATA || L2CC_PREFETCH_INST
	help
	  In some systems, it might be better to prefetch more in advance
	  to achieve better performance. The prefetch offset enables this
	  by setting the address of the prefetched cache line to
	  Cache Line + 1 + Offset. The optimal value of the prefetch offset
	  depends on the L3 read latency and on the L1 read issuing capability.
	  It is recommended to perform system experiments by varying
	  the prefetch offset, to find the optimal value.

config L2CC_DEBUG_DCL
	bool "DCL: Disable Cache Linefill"
	default n
	depends on CACHE_L2X0
	help
	  If you set the DCL bit to 1, no allocation occurs on either reads or
	  writes. This mode of operation is required for debug so that the
	  memory image, as seen by the processor, can be examined in a
	  non-invasive manner. Cache hits read data words from the cache, and
	  cache misses from a cacheable region read words directly from memory.

config L2CC_DEBUG_DWB
	bool "DWB: Diable Write-Back (force write-through)"
	default n
	depends on CACHE_L2X0
	help
	  If you set the DWB bit to 1, it forces the cache controller to treat
	  all cacheable writes as though they were in a write-through no write-
	  allocate region of memory. The setting of the DWB bit overrides the
	  access attributes. If the cache contains dirty cache lines, these
	  remain dirty while the DWB bit is set, unless they are written back
	  because of a write-back eviction after a linefill, or because of an
	  explicit clean operation.
	  While the DWB bit is set, lines that are clean are not marked as
	  dirty if they are updated. This functionality enables a debugger to
	  download code or data to external memory, without the requirement to
	  clean part or the entire cache to ensure that the code or data being
	  downloaded has been written to external memory.
	  If you have set the DWB bit to 1, and a write is made to a cache line
	  that is dirty, then both the cache line and the external memory are
	  updated with the write data.

comment "Ethernet MAC/PHY options"

config EMAC_QSIZE_TX
	int "Circular-buffer size for Tx"
	default 64
	depends on NET_LG115X_EMAC

config EMAC_QSIZE_RX
	int "Circular-buffer size for Rx"
	default 192
	depends on NET_LG115X_EMAC

config EPHY_NO_EEE
	bool "Disable Energy-Efficient Ethernet"
	default y
	depends on NET_LG115X_EMAC

comment "Miscellaneous options"

config TRUSTZONE
	bool "Cortex-A9 TrustZone support (non-secure mode kernel)"
	default y
	depends on CACHE_L2X0
	help
	  This option enables non-secure world kernel to support TrustZone(R)
	  technology integrated into ARM Cortex-A processors. Currently, only
	  level-2 cache controller support code is affected.

config ARCH_HIBERNATION_POSSIBLE
	def_bool n

endmenu
```

## kernel/power/lgsnap/Kconfig
```kconfig
menuconfig LGSNAP
	bool "LGSNAP support"
	depends on ARM
	depends on ARCH_SUSPEND_POSSIBLE || ARCH_HIBERNATION_POSSIBLE
	depends on PM_SLEEP
	default n
	help
	  This enables "LGSNAP" function based on swsuspend.

if LGSNAP
	config LGSNAP_COMPRESS
	bool "LGSNAP compress hibernation image"
	default n
	
choice 
	prompt "LGSNAP compress algorithm"
	depends on LGSNAP_COMPRESS
	default LGSNAP_COMPRESS_LZO
	help
	  This enables LGSNAP hibernation image compressing.
	
	config LGSNAP_COMPRESS_LZO
		bool "LZO"
		depends on LGSNAP_COMPRESS
		select CRYPTO_LZO
		help
		  Compress hibernation image using LZO algorithm

	config LGSNAP_COMPRESS_LZO_99x
		bool "LZO_999"
		depends on LGSNAP_COMPRESS
		select CRYPTO_LZO
		help
		  Compress hibernation image using LZO 99x algorithm

	config LGSNAP_COMPRESS_GZIP
		bool "GZIP"
		depends on LGSNAP_COMPRESS
		select CRYPTO_ZLIB
		help
		  Compress hibernation image using GZIP algorithm

endchoice	  

	config LGSNAP_COMP_TYPE
	int
	default 1 if LGSNAP_COMPRESS_LZO
	default 2 if LGSNAP_COMPRESS_LZO_999
	default 3 if LGSNAP_COMPRESS_GZIP
	default 0 if !LGSNAP_COMPRESS

	config LGSNAP_DEBUG
	bool "LGSNAP enabel debugging function"
	default n

	config LGSNAP_TEST
	bool "LGSNAP enabel test function"
	default n
endif
```
